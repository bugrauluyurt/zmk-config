## boards/shields/Lily58_dongle_prospector/Kconfig.defconfig
```kconfig
if SHIELD_LILY58_DONGLE_PROSPECTOR

config ZMK_KEYBOARD_NAME
    default "Lily58"

config ZMK_SPLIT_ROLE_CENTRAL
    default y

config ZMK_SPLIT
    default y

config ZMK_SPLIT_BLE_CENTRAL_PERIPHERALS
    default 2

config BT_MAX_CONN
    default 7

config BT_MAX_PAIRED
    default 7

endif
```

## boards/shields/Lily58_dongle_prospector/Kconfig.shield
```kconfig
config SHIELD_LILY58_DONGLE_PROSPECTOR
    def_bool $(shields_list_contains,Lily58_dongle_prospector)
```

## config/west.yml
```yaml
manifest:
  remotes:
    - name: zmkfirmware
      url-base: https://github.com/zmkfirmware
    - name: PandaKBLab
      url-base: https://github.com/PandaKBLab
    - name: mctechnology17
      url-base: https://github.com/mctechnology17
  projects:
    - name: zmk
      remote: zmkfirmware
      revision: v0.3
      import: app/west.yml
    - name: zmk-for-PandaKB
      remote: PandaKBLab
      revision: PandaKB_Lily58
    - name: zmk-nice-oled
      remote: mctechnology17
      revision: main
  self:
    path: config
```
